## CMakeLists.txt
```
cmake_minimum_required(VERSION 3.20.0)
find_package(Zephyr REQUIRED HINTS $ENV{ZEPHYR_BASE})
project(i2c_sensor)

if(DEFINED UNTRUSTED)
    message("#################################################")
    message("#################################################")
    message(STATUS "Building untrusted setup")
    message("#################################################")
    message("#################################################")
    target_compile_definitions(app PUBLIC UNTRUSTED)

    # OLED DRIVER
    if(DEFINED EMULATED)
        target_compile_definitions(app PUBLIC EMULATED)
    else()
        target_include_directories(app PRIVATE driver/oled_driver )
        target_include_directories(app PRIVATE driver/oled_driver/Config )
        target_include_directories(app PRIVATE driver/oled_driver/OLED )
        target_include_directories(app PRIVATE driver/oled_driver/GUI )
        target_include_directories(app PRIVATE driver/oled_driver/Example )
        file(GLOB_RECURSE oled_driver_sources CONFIGURE_DEPENDS driver/oled_driver/*.c)
    endif()

    target_include_directories(app PRIVATE src/ )

    # included because driver code is full of these warnings
    target_compile_options(app PRIVATE -Wno-missing-braces)
    target_compile_options(app PRIVATE -Wno-comment)

    target_sources(app PRIVATE
            ${oled_driver_sources}
            src/main.c
            trusted_peripheral/trusted_peripheral.c
    )
else()
    message("#################################################")
    message("#################################################")
    message(STATUS "Building trusted setup")
    message("#################################################")
    message("#################################################")
    target_compile_definitions(app PUBLIC TRUSTED)

    # NOTE force test flash layout for more flash memory
    set_property(TARGET zephyr_property_target
                 APPEND PROPERTY TFM_CMAKE_OPTIONS
                 -DTFM_S_REG_TEST=ON
                 #-DCRYPTO_HW_ACCELERATOR=OFF # doesn't work
    )

    target_sources(app PRIVATE
            src/main.c
            src/trusted_peripheral_ns.c
    )

    # secure partition
    get_target_property(TFM_BINARY_DIR tfm TFM_BINARY_DIR)
    configure_file(
      ${CMAKE_CURRENT_LIST_DIR}/trusted_peripheral/tfm_manifest_list.yaml.in
      ${CMAKE_CURRENT_BINARY_DIR}/trusted_peripheral/tfm_manifest_list.yaml
    )
    
    set_property(TARGET zephyr_property_target
      APPEND PROPERTY TFM_CMAKE_OPTIONS
      -DTFM_EXTRA_MANIFEST_LIST_FILES=${CMAKE_CURRENT_BINARY_DIR}/trusted_peripheral/tfm_manifest_list.yaml
      -DTFM_EXTRA_PARTITION_PATHS=${CMAKE_CURRENT_LIST_DIR}/trusted_peripheral
    )
    
if(DEFINED EMULATED)
    target_compile_definitions(app PUBLIC EMULATED)
    set_property(TARGET zephyr_property_target
      APPEND PROPERTY TFM_CMAKE_OPTIONS
      -DEMULATED=1
    )
else()
endif()
    
    # include folder that has tfm_api.h
    target_include_directories(app PRIVATE
      $<TARGET_PROPERTY:tfm,TFM_BINARY_DIR>/install/interface/include
    )
    
    target_compile_definitions(app
        PRIVATE TFM_PARTITION_TRUSTED_PERIPHERAL
    )
endif()
```

## Kconfig
```
mainmenu "MYAPP"

source "Kconfig.zephyr"
config MYAPP_STM32
  default y
  bool
  select USE_STM32_HAL_GPIO
  select USE_STM32_LL_GPIO
  select USE_STM32_HAL_I2C
  select USE_STM32_LL_I2C
  select USE_STM32_HAL_CORTEX
  select USE_STM32_LL_CORTEX
  select USE_STM32_HAL_SPI
  select USE_STM32_LL_SPI
  depends on HAS_STM32CUBE
```

## prj.conf
```kconfig
# for profiling using timing_start etc.
CONFIG_TIMING_FUNCTIONS=y

# for transmission rates testing
CONFIG_SERIAL=y

# Debug build
#CONFIG_TFM_CMAKE_BUILD_TYPE_DEBUG=y

# Release build with Debug info
#CONFIG_TFM_CMAKE_BUILD_TYPE_RELWITHDEBINFO=y

# Release build, optimized for size
#CONFIG_TFM_CMAKE_BUILD_TYPE_MINSIZEREL

CONFIG_SPEED_OPTIMIZATIONS=y
```

## tfm_config.conf
```kconfig
# All config options relating to TFM (usually meaning these options get passed to the tf-m build system)
#
# For what these options do, see 
# https://docs.zephyrproject.org/latest/kconfig.html
#
# Zephyr doesn’t cover every CMake argument supported by the TF-M build system.
# The TFM_CMAKE_OPTIONS property on the zephyr_property_target can be used to
# pass custom CMake arguments to the TF-M build system.
#
# To pass -DFOO=bar to the TF-M build system, place the following in your CMakeLists.txt
#
#   set_property(TARGET zephyr_property_target
#                APPEND PROPERTY TFM_CMAKE_OPTIONS
#                -DFOO=bar
#   )


CONFIG_BUILD_WITH_TFM=y               # TF-M will be built for the secure processing environment along with Zephyr
CONFIG_ARM_TRUSTZONE_M=y              # Platform has support for ARM TrustZone-M.
CONFIG_TRUSTED_EXECUTION_NONSECURE=y  # enable building a Non-Secure firmware image for a platform that supports Trusted Execution. 
                                      # A Non-Secure firmware image will execute in Non-Secure (Normal) state. Therefore, it shall not access
                                      # CPU resources (memory areas, peripherals, interrupts etc.) belonging to the
                                      # Secure domain.
CONFIG_TRUSTED_EXECUTION_SECURE=n     # enable building a Secure firmware image for a platform that supports Trusted Execution.
                                      # A Secure firmware image will execute in Secure state. It may allow the CPU to execute in Non-Secure
                                      # (Normal) state. Therefore, a Secure firmware image shall be able to
                                      # configure security attributions of CPU resources (memory areas,
                                      # peripherals, interrupts, etc.) as well as to handle faults, related to
                                      # security violations. It may optionally allow certain functions to be
                                      # called from the Non-Secure (Normal) domain.

CONFIG_TFM_PROFILE_TYPE_NOT_SET=y  # TF-M build profile is not set
CONFIG_TFM_PROFILE=                # Build profile used to build tfm_s image. values are profile_large, profile_medium, profile_small
CONFIG_TFM_PROFILE_SMALL=y         # above option cannot be used, set it like this instead
CONFIG_TFM_BUILD_NS=y              # builds tfm's non-secure app
CONFIG_TFM_USE_NS_APP=y            # uses tfm's non-secure app

CONFIG_TFM_REGRESSION_S=y          # include secure domain regression tests
CONFIG_TFM_REGRESSION_NS=y         # include non-secure domain regression tests

CONFIG_TFM_CONNECTION_BASED_SERVICE_API=y # The TF-M build system produces an
                                          # interface source file for accessing connection based services. Select this
                                          # option when TF-M service models requires this source fi
                                          # le. Note: This is an auto-generated configuration in the TF-M build system.
                                          # When this option is not enabled in the TF-M build system this will result in
                                          # compilation error.

# enabling of secure partitions
CONFIG_TFM_PARTITION_PROTECTED_STORAGE=y
CONFIG_TFM_PARTITION_INTERNAL_TRUSTED_STORAGE=y
CONFIG_TFM_PARTITION_CRYPTO=y
CONFIG_TFM_PARTITION_INITIAL_ATTESTATION=n
CONFIG_TFM_PARTITION_PLATFORM=y

CONFIG_TFM_QCBOR_PATH="DOWNLOAD" # Path to QCBOR or DOWNLOAD to fetch
                                 # automatically. Due to a license issue with this library Zephyr does not ship
                                 # with this library. Use this to point to own checkout or set to DOWNLOAD to
                                 # allow TF-M build system to download this library.

CONFIG_TFM_IPC=y             # enable IPC mode as opposed to SFN mode
CONFIG_TFM_ISOLATION_LEVEL=2 # default isolation level
```

## boards/mps2_an521.conf
```kconfig
# NOTE: larger stack size is needed. Otherwise some functions in the OLED
# driver can never be called and the board is just stuck (untrusted) or stuck
# in a boot loop (trusted)
CONFIG_MAIN_STACK_SIZE=4096

# NOTE a combination of these enables "%f" for printf
CONFIG_SHELL=y
CONFIG_SENSOR_SHELL=y
CONFIG_SENSOR=y

#
# UNTRUSTED
#
# for crypto support in untrusted setup
CONFIG_CRYPTO=y
CONFIG_MBEDTLS=y
CONFIG_MBEDTLS_BUILTIN=y
CONFIG_MBEDTLS_ENABLE_HEAP=y
CONFIG_MBEDTLS_HEAP_SIZE=32768
CONFIG_MBEDTLS_PSA_CRYPTO_C=y
CONFIG_MBEDTLS_CFG_FILE="config-tls-generic.h"
CONFIG_MBEDTLS_ENTROPY_ENABLED=y
CONFIG_MBEDTLS_ZEPHYR_ENTROPY=y
CONFIG_TEST_RANDOM_GENERATOR=y
CONFIG_ENTROPY_GENERATOR=y
#CONFIG_MBEDTLS_PSA_CRYPTO_STORAGE_C=y
#CONFIG_PSA_NATIVE_ITS=y
```

## boards/mps2_an521_ns.conf
```kconfig
# NOTE: larger stack size is needed. Otherwise some functions in the OLED
# driver can never be called and the board is just stuck (untrusted) or stuck
# in a boot loop (trusted)
CONFIG_MAIN_STACK_SIZE=4096

# NOTE a combination of these enables "%f" for printf
CONFIG_SHELL=y
CONFIG_SENSOR_SHELL=y
CONFIG_SENSOR=y

#
# TRUSTED SETUP
#
CONFIG_BUILD_WITH_TFM=y
CONFIG_TFM_PROFILE_TYPE_NOT_SET=y
#CONFIG_TFM_CONNECTION_BASED_SERVICE_API=y

# FORCE SFN
CONFIG_TFM_IPC=n
CONFIG_TFM_SFN=y
```

## boards/nucleo_l552ze_q.conf
```kconfig
#
# SENSOR
#
CONFIG_GPIO=y
CONFIG_I2C=y
CONFIG_I2C_STM32=y

CONFIG_SPI=y
CONFIG_SPI_STM32=y

# NOTE a combination of these enables "%f" for printk
CONFIG_SHELL=y
CONFIG_I2C_SHELL=y
CONFIG_SENSOR_SHELL=y
CONFIG_SENSOR=y

# NOTE: larger stack size is needed. Otherwise some functions in the OLED
# driver can never be called and the board is just stuck (untrusted) or stuck
# in a boot loop (trusted)
CONFIG_MAIN_STACK_SIZE=4096

#
# UNTRUSTED
#
# for crypto support in untrusted setup
CONFIG_CRYPTO=y
CONFIG_MBEDTLS=y
#CONFIG_MBEDTLS_BUILTIN=n
CONFIG_MBEDTLS_BUILTIN=y
CONFIG_MBEDTLS_ENABLE_HEAP=y
CONFIG_MBEDTLS_HEAP_SIZE=32768
#CONFIG_MBEDTLS_HEAP_SIZE=16384
#CONFIG_MBEDTLS_HEAP_SIZE=8192
CONFIG_MBEDTLS_PSA_CRYPTO_C=y
# CONFIG_CRYPTO_STM32=y # doesn't work, no crypto accelerator
#CONFIG_MBEDTLS_CFG_FILE="config-tls-generic.h"
CONFIG_MBEDTLS_ENTROPY_ENABLED=y
CONFIG_MBEDTLS_ZEPHYR_ENTROPY=y
CONFIG_TEST_RANDOM_GENERATOR=y
CONFIG_ENTROPY_GENERATOR=y

#CONFIG_MBEDTLS_PSA_CRYPTO_STORAGE_C=y
#CONFIG_PSA_NATIVE_ITS=y
```

## boards/nucleo_l552ze_q_ns.conf
```kconfig
#
# SENSOR
#
CONFIG_GPIO=y
CONFIG_I2C=y
CONFIG_I2C_STM32=y

CONFIG_SPI=y
CONFIG_SPI_STM32=y

# NOTE a combination of these enables "%f" for printk
CONFIG_SHELL=y
CONFIG_I2C_SHELL=y
CONFIG_SENSOR_SHELL=y
CONFIG_SENSOR=y


#
# PARTITION
#
CONFIG_BUILD_WITH_TFM=y
CONFIG_TFM_PROFILE_TYPE_NOT_SET=n

CONFIG_TFM_PARTITION_CRYPTO=y

# The TF-M build system produces an interface source file for accessing
# connection based services. Select this option when TF-M service models
# requires this source file. Note: This is an auto-generated configuration in
# the TF-M build system. When this option is not enabled in the TF-M build
# system this will result in compilation error.
#CONFIG_TFM_CONNECTION_BASED_SERVICE_API=y


# NOTE: larger stack size is needed. Otherwise some functions in the OLED
# driver can never be called and the board is just stuck (untrusted) or stuck
# in a boot loop (trusted)
CONFIG_MAIN_STACK_SIZE=4096

# FORCE SFN
CONFIG_TFM_IPC=n
CONFIG_TFM_SFN=y
```

## src/main.c
```c
#include <zephyr/kernel.h>
#include <zephyr/device.h>
#include <zephyr/drivers/gpio.h>
#include <zephyr/drivers/i2c.h>

#include <psa/crypto.h>

#ifdef UNTRUSTED
#else
  #include <tfm_ns_interface.h>
#endif

#include "trusted_peripheral.h"

#ifdef EMULATED
    //#define GET_TICK() sys_clock_elapsed()
    #define GET_TICK() k_uptime_ticks()
#else
    #define GET_TICK() HAL_GetTick()
#endif

#include <zephyr/timing/timing.h> /* for profiling */

// TODO uart transmission
#include <zephyr/drivers/uart.h>  /* for transmission */
#define UART_DEVICE_NODE DT_CHOSEN(zephyr_shell_uart)
static const struct device *const uart_dev = DEVICE_DT_GET(UART_DEVICE_NODE);

#define TEST_PERFORMANCE_TRUSTED_CAPTURE      1
#define TEST_PERFORMANCE_TRUSTED_DELIVERY     0
#define TEST_PERFORMANCE_TRUSTED_TRANSFORM    0
#define TEST_PERFORMANCE_TRUSTED_HANDLE       0
#define TEST_PERFORMANCE_CONTEXT_SWITCH       0

#define TEST_TRANSMISSION_TRUSTED_CAPTURE     0
#define TEST_TRANSMISSION_TRUSTED_DELIVERY    0
#define TEST_TRANSMISSION_TRUSTED_TRANSFORM   0
#define TEST_TRANSMISSION_TRUSTED_HANDLE      0

#define SENSOR_READINGS 10

// TODO we can move these
#if TEST_TRANSMISSION_TRUSTED_CAPTURE
struct packet_t {
    tp_mac_t       mac;
    sensor_data_t  data;
} packet;
#endif
#if TEST_TRANSMISSION_TRUSTED_DELIVERY
struct packet_t {
    uint8_t   ciphertext[ENCRYPTED_SENSOR_DATA_SIZE];
    tp_mac_t  mac;
} packet;
#endif
#if TEST_TRANSMISSION_TRUSTED_TRANSFORM
struct packet_t {
    trusted_transform_t tt;
} packet;
#endif
#if TEST_TRANSMISSION_TRUSTED_HANDLE
struct packet_t {
    tt_handle_cipher_t hc;
} packet;
#endif

int main(void)
{
    timing_init();
    psa_status_t ret = tp_init();
    if (ret != 0) { printk("Initializing TP service failed with status: %i\n", ret); }

    /* blink red led to signal start */
    #if !defined(EMULATED)
    HAL_GPIO_TogglePin(GPIOA, GPIO_PIN_9);
    HAL_Delay(100);
    HAL_GPIO_TogglePin(GPIOA, GPIO_PIN_9);
    #endif

#if TEST_PERFORMANCE_TRUSTED_CAPTURE
    tp_mac_t      mac  = {0};
    sensor_data_t data = {0};

    printk("PROFILING TC START\n");

    timing_start();
    for (int i = 0; i < 100; i++)
    {
        uint64_t tick_begin = GET_TICK(); /* NOTE tick increments for every ms. */
        timing_t cycle_begin = timing_counter_get();

        /* use our trusted peripheral api */
        psa_status_t ret = tp_trusted_capture(&data, &mac);
        if (ret != 0) { printk("Trusted Capture failed with status: %i\n", ret); }

        uint64_t tick_end  = GET_TICK();
        timing_t cycle_end = timing_counter_get();
        uint64_t cycles    = timing_cycles_get(&cycle_begin, &cycle_end);
        uint64_t nanosecs  = timing_cycles_to_ns(cycles);

        //printk("(%" PRIu64 "", cycles);
        printk("%" PRIu64 "\n", nanosecs);
        //printk("%" PRIu64 " ms\n", tick_end - tick_begin);
        //printk("%u ms\n", tick_end - tick_begin);

        //printk("Temp: %f ",  data.temp);
        //printk("Humidity: %f\n", data.humidity);
    }
    timing_stop();

    /* toggle red led on to signal we are finished */
    #if !defined(EMULATED)
    HAL_GPIO_TogglePin(GPIOA, GPIO_PIN_9);
    #endif

    return 0;
#endif

#if TEST_PERFORMANCE_TRUSTED_DELIVERY
    uint8_t   ciphertext[ENCRYPTED_SENSOR_DATA_SIZE] = {0};
    tp_mac_t  mac                                    = {0};

    printk("PROFILING TD START\n");

    timing_start();
    for (int i = 0; i < 1000; i++)
    {
        timing_t cycle_begin = timing_counter_get();

        psa_status_t ret = tp_trusted_delivery(ciphertext, &mac);
        if (ret != 0) { printk("Trusted Capture failed with status: %i\n", ret); }

        timing_t cycle_end = timing_counter_get();
        uint64_t cycles    = timing_cycles_get(&cycle_begin, &cycle_end);
        uint64_t nanosecs  = timing_cycles_to_ns(cycles);

        printk("%" PRIu64 "\n", nanosecs);
    }
    timing_stop();

    #if !defined(EMULATED)
    HAL_GPIO_TogglePin(GPIOA, GPIO_PIN_9);
    #endif

    return 0;
#endif

#if TEST_PERFORMANCE_TRUSTED_TRANSFORM

    trusted_transform_t tt = {0};

    printk("PROFILING TT START\n");

    timing_start();
    for (int i = 0; i < 100; i++)
    {
        timing_t cycle_begin = timing_counter_get();

        transform_t transform = {0};
        psa_status_t ret = tp_trusted_transform(&tt, transform);
        if (ret != 0) { printk("Trusted Transform init failed with status: %i\n", ret); }

        /* perform example transformation */
        transform.type = TRANSFORM_ID_CONVERT_CELCIUS_TO_FAHRENHEIT;
        transform.convert_params[0] = 1.8f;
        transform.convert_params[1] = 32.f;
        tp_trusted_transform(&tt, transform);

        transform.type = TRANSFORM_ID_CONVERT_FAHRENHEIT_TO_CELCIUS;
        tp_trusted_transform(&tt, transform);

        transform.type = TRANSFORM_ID_CONVERT_CELCIUS_TO_FAHRENHEIT;
        tp_trusted_transform(&tt, transform);

        transform.type = TRANSFORM_ID_CONVERT_FAHRENHEIT_TO_CELCIUS;
        tp_trusted_transform(&tt, transform);

        transform.type = TRANSFORM_ID_CONVERT_CELCIUS_TO_FAHRENHEIT;
        tp_trusted_transform(&tt, transform);

        timing_t cycle_end = timing_counter_get();
        uint64_t cycles    = timing_cycles_get(&cycle_begin, &cycle_end);
        uint64_t nanosecs  = timing_cycles_to_ns(cycles);

        printk("%" PRIu64 "\n", nanosecs);
    }
    timing_stop();

    #if !defined(EMULATED)
    HAL_GPIO_TogglePin(GPIOA, GPIO_PIN_9);
    #endif

    return 0;

#endif

#if TEST_PERFORMANCE_TRUSTED_HANDLE
    printk("PROFILING TH START\n");

    tt_handle_cipher_t hc = {0};

    timing_start();
    for (int i = 0; i < 100; i++)
    {
        timing_t cycle_begin = timing_counter_get();

        transform_t transform = {0};
        psa_status_t ret = tp_trusted_handle(&hc, transform);
        if (ret != 0) { printk("Trusted Handle init failed with status: %i\n", ret); }

        /* perform example transformation */
        transform.type = TRANSFORM_ID_CONVERT_CELCIUS_TO_FAHRENHEIT;
        transform.convert_params[0] = 1.8f;
        transform.convert_params[1] = 32.f;
        tp_trusted_handle(&hc, transform);

        transform.type = TRANSFORM_ID_CONVERT_FAHRENHEIT_TO_CELCIUS;
        tp_trusted_handle(&hc, transform);

        transform.type = TRANSFORM_ID_CONVERT_CELCIUS_TO_FAHRENHEIT;
        tp_trusted_handle(&hc, transform);

        transform.type = TRANSFORM_ID_CONVERT_FAHRENHEIT_TO_CELCIUS;
        tp_trusted_handle(&hc, transform);

        transform.type = TRANSFORM_ID_CONVERT_CELCIUS_TO_FAHRENHEIT;
        tp_trusted_handle(&hc, transform);

        transform.type = TRANSFORM_RESOLVE_HANDLE_AND_ENCRYPT,
        tp_trusted_handle(&hc, transform);

        timing_t cycle_end = timing_counter_get();
        uint64_t cycles    = timing_cycles_get(&cycle_begin, &cycle_end);
        uint64_t nanosecs  = timing_cycles_to_ns(cycles);

        printk("%" PRIu64 "\n", nanosecs);
    }
    timing_stop();

    #if !defined(EMULATED)
    HAL_GPIO_TogglePin(GPIOA, GPIO_PIN_9);
    #endif

    return 0;
#endif

#if TEST_PERFORMANCE_CONTEXT_SWITCH
    /* calculate some value ten thousand times */
    for (int i = 0; i < 10000; i++)
    {
        timing_t cycle_begin = timing_counter_get();

        uint64_t result = 0;
        measure_context_switch(&result, i);

        timing_t cycle_end = timing_counter_get();
        uint64_t cycles    = timing_cycles_get(&cycle_begin, &cycle_end);
        uint64_t nanosecs  = timing_cycles_to_ns(cycles);

        printk("%" PRIu64 "\n",      nanosecs);
    }

#endif


#if TEST_TRANSMISSION_TRUSTED_CAPTURE
    printk("MEASURING TRANSMISSION %u TC START\n", SENSOR_READINGS);
    uint32_t tick_begin = GET_TICK();
    for (int i = 0; i < SENSOR_READINGS; i++)
    {
        /* use our trusted peripheral api */
        psa_status_t ret = tp_trusted_capture(&packet.data, &packet.mac);
        if (ret != 0) { printk("Trusted Capture failed with status: %i\n", ret); }

        /* transmit TODO rewrite */
        for (int i = 0; i < sizeof(packet); i++) {
            uart_poll_out(uart_dev, ((uint8_t*) &packet)[i]);
        }
    }
    uint32_t tick_end  = GET_TICK();
    printk("\n");
    printk("MEASURING END WITH: %u ms\n", tick_end - tick_begin);

    return 0;
#endif

#if TEST_TRANSMISSION_TRUSTED_DELIVERY
    printk("MEASURING TRANSMISSION %u TD START\n", SENSOR_READINGS);
    uint32_t tick_begin = GET_TICK();
    for (int i = 0; i < SENSOR_READINGS; i++)
    {
        /* use our trusted peripheral api */
        psa_status_t ret = tp_trusted_delivery(&packet.ciphertext, &packet.mac);
        if (ret != 0) { printk("Trusted Capture failed with status: %i\n", ret); }

        /* transmit TODO rewrite */
        for (int i = 0; i < sizeof(packet); i++) {
            uart_poll_out(uart_dev, ((uint8_t*) &packet)[i]);
        }
    }
    uint32_t tick_end  = GET_TICK();
    printk("\n");
    printk("MEASURING END WITH: %u ms\n", tick_end - tick_begin);

    return 0;
#endif

#if TEST_TRANSMISSION_TRUSTED_TRANSFORM
    printk("MEASURING TRANSMISSION %u TT START\n", SENSOR_READINGS);
    uint32_t tick_begin = GET_TICK();
    for (int i = 0; i < SENSOR_READINGS; i++)
    {
        transform_t transform = {0};
        psa_status_t ret = tp_trusted_transform(&packet.tt, transform);
        if (ret != 0) { printk("Trusted Transform init failed with status: %i\n", ret); }

        /* perform example transformation */
        transform.type = TRANSFORM_ID_CONVERT_CELCIUS_TO_FAHRENHEIT;
        transform.convert_params[0] = 1.8f;
        transform.convert_params[1] = 32.f;
        tp_trusted_transform(&packet.tt, transform);

        transform.type = TRANSFORM_ID_CONVERT_FAHRENHEIT_TO_CELCIUS;
        tp_trusted_transform(&packet.tt, transform);

        transform.type = TRANSFORM_ID_CONVERT_CELCIUS_TO_FAHRENHEIT;
        tp_trusted_transform(&packet.tt, transform);

        transform.type = TRANSFORM_ID_CONVERT_FAHRENHEIT_TO_CELCIUS;
        tp_trusted_transform(&packet.tt, transform);

        transform.type = TRANSFORM_ID_CONVERT_CELCIUS_TO_FAHRENHEIT;
        tp_trusted_transform(&packet.tt, transform);

        /* transmit */
        for (int i = 0; i < sizeof(packet); i++) {
            uart_poll_out(uart_dev, ((uint8_t*) &packet)[i]);
        }
    }
    uint32_t tick_end  = GET_TICK();
    printk("\n");
    printk("MEASURING END WITH: %u ms\n", tick_end - tick_begin);
#endif

#if TEST_TRANSMISSION_TRUSTED_HANDLE
    printk("MEASURING TRANSMISSION %u TH START\n", SENSOR_READINGS);
    uint32_t tick_begin = GET_TICK();
    for (int i = 0; i < SENSOR_READINGS; i++)
    {
        transform_t transform = {0};
        psa_status_t ret = tp_trusted_handle(&packet.hc, transform);
        if (ret != 0) { printk("Trusted Handle init failed with status: %i\n", ret); }

        /* perform example transformation */
        transform.type = TRANSFORM_ID_CONVERT_CELCIUS_TO_FAHRENHEIT;
        transform.convert_params[0] = 1.8f;
        transform.convert_params[1] = 32.f;
        tp_trusted_handle(&packet.hc, transform);

        transform.type = TRANSFORM_ID_CONVERT_FAHRENHEIT_TO_CELCIUS;
        tp_trusted_handle(&packet.hc, transform);

        transform.type = TRANSFORM_ID_CONVERT_CELCIUS_TO_FAHRENHEIT;
        tp_trusted_handle(&packet.hc, transform);

        transform.type = TRANSFORM_ID_CONVERT_FAHRENHEIT_TO_CELCIUS;
        tp_trusted_handle(&packet.hc, transform);

        transform.type = TRANSFORM_ID_CONVERT_CELCIUS_TO_FAHRENHEIT;
        tp_trusted_handle(&packet.hc, transform);

        transform.type = TRANSFORM_RESOLVE_HANDLE_AND_ENCRYPT,
        tp_trusted_handle(&packet.hc, transform);

        /* transmit */
        for (int i = 0; i < sizeof(packet); i++) {
            uart_poll_out(uart_dev, ((uint8_t*) &packet)[i]);
        }
    }
    uint32_t tick_end  = GET_TICK();
    printk("\n");
    printk("MEASURING END WITH: %u ms\n", tick_end - tick_begin);
#endif

#if 0 // Tests all API calls
    timing_init();

    tp_mac_t mac = {0};
    uint8_t ciphertext[ENCRYPTED_SENSOR_DATA_SIZE] = {0};
    transform_t transforms[TP_MAX_TRANSFORMS] = {0};
    trusted_transform_t tt = {0};
    tt_handle_cipher_t hc = {0};

    psa_status_t ret = tp_init();
    if (ret != 0) { printk("Initializing TP service failed with status: %i\n", ret); }

    for (;;)
    {
        timing_start();
        uint32_t tick_begin = GET_TICK(); /* NOTE tick increments for every ms. */
        timing_t cycle_begin = timing_counter_get();

        /* use our trusted peripheral api */
        sensor_data_t sensor_data = {0};
        psa_status_t ret = tp_trusted_capture(&sensor_data, &mac);
        if (ret != 0) { printk("Trusted Capture failed with status: %i\n", ret); }

        ret = tp_trusted_delivery(ciphertext, &mac);
        if (ret != 0) { printk("Trusted Delivery failed with status: %i\n", ret); }

        transform_t transform = {0};
        ret = tp_trusted_transform(&tt, transform);
        if (ret != 0) { printk("Trusted Transform init failed with status: %i\n", ret); }

        /* perform example transformation */
        transform.type = TRANSFORM_ID_CONVERT_CELCIUS_TO_FAHRENHEIT;
        transform.convert_params[0] = 1.8f;
        transform.convert_params[1] = 32.f;
        tp_trusted_transform(&tt, transform);
        transform.type = TRANSFORM_ID_CONVERT_FAHRENHEIT_TO_CELCIUS;
        tp_trusted_transform(&tt, transform);

        transform_t transform_2 = {0};
        ret = tp_trusted_handle(&hc, transform_2);
        if (ret != 0) { printk("Trusted Handle init failed with status: %i\n", ret); }
        transform_2.type = TRANSFORM_RESOLVE_HANDLE_AND_ENCRYPT;
        ret = tp_trusted_handle(&hc, transform_2);
        if (ret != 0) { printk("Trusted Handle encryption failed with status: %i\n", ret); }

        // printk("CIPHER: ");
        // for (int i = 0; i < ENCRYPTED_SENSOR_DATA_SIZE; i++)
        // {
        //     printk("%02x", hc.ciphertext[i]);
        // }
        // printk("\n");

        uint32_t tick_end  = GET_TICK();
        timing_t cycle_end = timing_counter_get(); // there is also timing_cycles_to_ns_avg()
        uint64_t cycles    = timing_cycles_get(&cycle_begin, &cycle_end);
        uint64_t nanosecs  = timing_cycles_to_ns(cycles);
        timing_stop();

        printk("(%" PRIu64 " cycles) ", cycles);
        printk("(%" PRIu64 " ns) ", nanosecs);
        printk("(%u ms) ", tick_end - tick_begin);
        printk("Temp: %f ",  tt.data.temp);
        printk("Humidity: %f\n", tt.data.humidity);


        printk("HASH: ");
        for (int i = 0; i < MAC_HASH_SIZE; i++)
        {
            printk("%02x", mac.hash[i]);
        }
        printk("\n");

        printk("SIGN: ");
        for (int i = 0; i < MAC_SIGN_SIZE; i++)
        {
            printk("%02x", mac.sign[i]);
        }
        printk("\n");

        #ifdef EMULATED
        //k_sleep(K_MSEC(10000000)); // emulated mps2_an521 is too fast
        #endif
    }
#endif

    return 0;
}
```

## src/trusted_peripheral.h
```c
#ifdef UNTRUSTED
  #include <stdint.h> // for int32_t
  #include <stddef.h> // for size_t
  typedef int32_t psa_status_t;
#else
  #include "tfm_api.h"
#endif

// PSA_HASH_MAX_SIZE      64
// PSA_SIGNATURE_MAX_SIZE 512
#define MAC_HASH_SIZE 32
#define MAC_SIGN_SIZE 128
typedef struct {
    uint8_t hash[MAC_HASH_SIZE];
    uint8_t sign[MAC_SIGN_SIZE];
} tp_mac_t;

#define TP_API_INIT           33
#define TP_TRUSTED_DELIVERY   34
#define TP_TRUSTED_CAPTURE    35
#define TP_TRUSTED_TRANSFORM  36
#define TP_TRUSTED_HANDLE     37
#define MEASURE_PERFORMANCE   38/* not part of TPI api */

psa_status_t tp_init();

psa_status_t tp_sensor_data_get(float* temp, float* humidity, tp_mac_t* mac_out);


/*
** TRUSTED CAPTURE
*/

typedef struct
{
    float temp;
    float humidity;
} sensor_data_t;

psa_status_t tp_trusted_capture(sensor_data_t* data_out, tp_mac_t* mac_out);

/*
** TRUSTED DELIVERY
*/

/* normal application doesn't know about sensor_data_t in case of trusted delivery */
#define ENCRYPTED_SENSOR_DATA_SIZE 128

psa_status_t tp_trusted_delivery(void* data_out, tp_mac_t* mac_out);


/*
** TRUSTED TRANSFORM
*/
#define TP_MAX_TRANSFORMS 6
typedef enum
{
    TRANSFORM_ID_INITIAL,                       /* signals initial data capture */
    TRANSFORM_RESOLVE_HANDLE_AND_ENCRYPT,       /* for handle version of trusted transformation */
    TRANSFORM_ID_CONVERT_CELCIUS_TO_FAHRENHEIT, // (celsius * 9/5) + 32;
    TRANSFORM_ID_CONVERT_FAHRENHEIT_TO_CELCIUS, // (fahrenheit - 32) / 1.8;
    TRANSFORM_ID_CENSOR_FACES,
    TRANSFORM_ID_CROP_PHOTO,
    /* ... */
    TRANSFORM_ID_COUNT,
} transform_id;

typedef struct
{
    transform_id type;
    union
    {
        float convert_params[2];
    };
} transform_t;

typedef struct
{
    sensor_data_t data;
    transform_t   list[TP_MAX_TRANSFORMS];
    tp_mac_t      mac;
} trusted_transform_t;

psa_status_t tp_trusted_transform(trusted_transform_t* data_io, transform_t transform);

/* non-IPC version: */
//psa_status_t tp_trusted_transform(sensor_data_t* data_io, transform_t* list_io,
//                                  tp_mac_t* mac_io, transform_t transform);

/*
** TRUSTED TRANSFORM VIA HANDLES
*/
typedef void* tt_handle_t;
typedef struct
{
    tt_handle_t handle;
    uint8_t     ciphertext[ENCRYPTED_SENSOR_DATA_SIZE];
    tp_mac_t    mac;
} tt_handle_cipher_t;
psa_status_t tp_trusted_handle(tt_handle_cipher_t* hc, transform_t transform);

/* non-IPC version: */
// psa_status_t tp_trusted_handle(tt_handle_t handle_io, transform_t transform, uint8_t* ciphertext);


/* measure context switch performance, not part of TP api */
psa_status_t measure_context_switch(uint64_t* res_out, uint32_t number);
```

## src/trusted_peripheral_ns.c
```c
#include "trusted_peripheral.h"

/*
** Implements the tp_api to pass execution over to the secure side over an IPC or SFN mechanism
*/

#include <tfm_ns_interface.h>

#if defined(CONFIG_TFM_IPC)
#include "psa/client.h"
#endif
#include "psa_manifest/sid.h"

psa_status_t tp_init()
{
    psa_status_t status;
    uint32_t api_call = TP_API_INIT;

    psa_outvec out_vec[] = { { .base = NULL, .len = 0 } };

    /* NOTE we encode our api call into the in_vec to be able to dispatch in the IPC case */
    psa_invec  in_vec[]  = { { .base = &api_call, .len = sizeof(uint32_t) } };

    #if defined(CONFIG_TFM_IPC)
        printf("USING IPC: ");

        psa_handle_t handle;
        handle = psa_connect(TFM_TRUSTED_PERIPHERAL_SID, TFM_TRUSTED_PERIPHERAL_VERSION);
        if (!PSA_HANDLE_IS_VALID(handle)) { return PSA_ERROR_GENERIC_ERROR; }

        status = psa_call(handle, PSA_IPC_CALL, in_vec, IOVEC_LEN(in_vec), out_vec, IOVEC_LEN(out_vec));

        psa_close(handle);
    #else
        printf("USING SFN\n");

        status = psa_call(TFM_TRUSTED_PERIPHERAL_HANDLE, api_call, in_vec, IOVEC_LEN(in_vec), out_vec, IOVEC_LEN(out_vec));
    #endif

    return status;
}

psa_status_t tp_trusted_capture(sensor_data_t* data_out, tp_mac_t* mac_out)
{
    psa_status_t status;
    uint32_t api_call = TP_TRUSTED_CAPTURE;

    psa_outvec out_vec[] = {
        { .base = data_out,     .len = sizeof(sensor_data_t)     },
        { .base = mac_out,      .len = sizeof(tp_mac_t) },
    };

    /* NOTE we encode our api call into the in_vec to be able to dispatch in the IPC case */
    psa_invec  in_vec[]  = { { .base = &api_call, .len = sizeof(uint32_t) } };

#if defined(CONFIG_TFM_IPC)

    psa_handle_t handle;
    handle = psa_connect(TFM_TRUSTED_PERIPHERAL_SID, TFM_TRUSTED_PERIPHERAL_VERSION);
    if (!PSA_HANDLE_IS_VALID(handle)) { return PSA_ERROR_GENERIC_ERROR; }

    status = psa_call(handle, PSA_IPC_CALL, in_vec, IOVEC_LEN(in_vec), out_vec, IOVEC_LEN(out_vec));

    psa_close(handle);
#else
    status = psa_call(TFM_TRUSTED_PERIPHERAL_HANDLE, api_call, in_vec, IOVEC_LEN(in_vec), out_vec, IOVEC_LEN(out_vec));
#endif
}

psa_status_t tp_trusted_delivery(void* data_out, tp_mac_t* mac_out)
{
    psa_status_t status;
    uint32_t api_call = TP_TRUSTED_DELIVERY;

    psa_outvec out_vec[] = {
        { .base = data_out,     .len = ENCRYPTED_SENSOR_DATA_SIZE },
        { .base = mac_out,      .len = sizeof(tp_mac_t)           },
    };

    /* NOTE we encode our api call into the in_vec to be able to dispatch in the IPC case */
    psa_invec  in_vec[]  = { { .base = &api_call, .len = sizeof(uint32_t) } };

#if defined(CONFIG_TFM_IPC)

    psa_handle_t handle;
    handle = psa_connect(TFM_TRUSTED_PERIPHERAL_SID, TFM_TRUSTED_PERIPHERAL_VERSION);
    if (!PSA_HANDLE_IS_VALID(handle)) { return PSA_ERROR_GENERIC_ERROR; }

    status = psa_call(handle, PSA_IPC_CALL, in_vec, IOVEC_LEN(in_vec), out_vec, IOVEC_LEN(out_vec));

    psa_close(handle);
#else
    status = psa_call(TFM_TRUSTED_PERIPHERAL_HANDLE, api_call, in_vec, IOVEC_LEN(in_vec), out_vec, IOVEC_LEN(out_vec));
#endif
}

psa_status_t tp_trusted_transform(trusted_transform_t* data_io, transform_t transform)
{
    psa_status_t status;
    uint32_t api_call = TP_TRUSTED_TRANSFORM;

    psa_outvec out_vec[] = {
        { .base = data_io,     .len = sizeof(trusted_transform_t)                   },
    };

    /* NOTE we encode our api call into the in_vec to be able to dispatch in the IPC case */
    psa_invec  in_vec[]  = {
        { .base = &api_call,  .len = sizeof(uint32_t)                        },
        { .base = &transform, .len = sizeof(transform_t)                     },
        { .base = data_io,    .len = sizeof(trusted_transform_t)             },
    };

#if defined(CONFIG_TFM_IPC)
    psa_handle_t handle;
    handle = psa_connect(TFM_TRUSTED_PERIPHERAL_SID, TFM_TRUSTED_PERIPHERAL_VERSION);
    if (!PSA_HANDLE_IS_VALID(handle)) { return PSA_ERROR_GENERIC_ERROR; }

    status = psa_call(handle, PSA_IPC_CALL, in_vec, IOVEC_LEN(in_vec), out_vec, IOVEC_LEN(out_vec));

    psa_close(handle);
#else
    status = psa_call(TFM_TRUSTED_PERIPHERAL_HANDLE, api_call, in_vec, IOVEC_LEN(in_vec), out_vec, IOVEC_LEN(out_vec));
#endif
}

psa_status_t tp_trusted_handle(tt_handle_cipher_t* hc, transform_t transform)
{
    psa_status_t status;
    uint32_t api_call = TP_TRUSTED_HANDLE;

    psa_outvec out_vec[] = {
        { .base = hc,          .len = sizeof(tt_handle_cipher_t)     },
    };

    /* NOTE we encode our api call into the in_vec to be able to dispatch in the IPC case */
    psa_invec  in_vec[]  = {
        { .base = &api_call,  .len = sizeof(uint32_t)                },
        { .base = &transform, .len = sizeof(transform_t)             },
        { .base = hc,         .len = sizeof(tt_handle_cipher_t)      },
    };

#if defined(CONFIG_TFM_IPC)
    psa_handle_t handle;
    handle = psa_connect(TFM_TRUSTED_PERIPHERAL_SID, TFM_TRUSTED_PERIPHERAL_VERSION);
    if (!PSA_HANDLE_IS_VALID(handle)) { return PSA_ERROR_GENERIC_ERROR; }

    status = psa_call(handle, PSA_IPC_CALL, in_vec, IOVEC_LEN(in_vec), out_vec, IOVEC_LEN(out_vec));

    psa_close(handle);
#else
    status = psa_call(TFM_TRUSTED_PERIPHERAL_HANDLE, api_call, in_vec, IOVEC_LEN(in_vec), out_vec, IOVEC_LEN(out_vec));
#endif
}


/* measures context switch performance, not part of TP api */
psa_status_t measure_context_switch(uint64_t* res_out, uint32_t number)
{
    psa_status_t status;
    uint32_t api_call = MEASURE_PERFORMANCE;

    psa_outvec out_vec[] = {
        { .base = res_out, .len = sizeof(uint64_t) },
    };

    /* NOTE we encode our api call into the in_vec to be able to dispatch in the IPC case */
    psa_invec  in_vec[]  = {
        { .base = &api_call, .len = sizeof(uint32_t) },
        { .base = &number,   .len = sizeof(uint32_t) }
    };

#if defined(CONFIG_TFM_IPC)
    psa_handle_t handle;
    handle = psa_connect(TFM_TRUSTED_PERIPHERAL_SID, TFM_TRUSTED_PERIPHERAL_VERSION);
    if (!PSA_HANDLE_IS_VALID(handle)) { return PSA_ERROR_GENERIC_ERROR; }

    status = psa_call(handle, PSA_IPC_CALL, in_vec, IOVEC_LEN(in_vec), out_vec, IOVEC_LEN(out_vec));

    psa_close(handle);
#else
    status = psa_call(TFM_TRUSTED_PERIPHERAL_HANDLE, api_call, in_vec, IOVEC_LEN(in_vec), out_vec, IOVEC_LEN(out_vec));
#endif
}
```
